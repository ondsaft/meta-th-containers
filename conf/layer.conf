## conf/layer.conf
```bitbake
# We have a conf and classes directory, add to BBPATH
BBPATH .= ":${LAYERDIR}"

# We have recipes-* directories, add to BBFILES
BBFILES += "${LAYERDIR}/recipes-*/*/*.bb \
            ${LAYERDIR}/recipes-*/*/*.bbappend"

BBFILE_COLLECTIONS += "meta-th-container"
BBFILE_PATTERN_meta-th-container = "^${LAYERDIR}/"
BBFILE_PRIORITY_meta-th-container = "6"

LAYERDEPENDS_meta-th-container = "core"
LAYERSERIES_COMPAT_meta-th-container = "kirkstone wrl mickledore"
```
